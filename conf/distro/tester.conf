## conf/distro/tester.conf
```bitbake
require conf/distro/poky.conf

DISTRO = "tester"
DISTRO_NAME = "Tester Distro"

# Follow the Poky format of <Version>+<type>-<date>
DISTRO_VERSION = "${XILINX_VER_MAIN}+${XILINX_VER_UPDATE}-${XILINX_VER_BUILD}"

XILINX_RELEASE_VERSION = "v2024.2"

# Configure default users/groups
# Default rules (assumed no debug-tweaks image feature):
# * disabled root login (set by system default)
# * Add a user with no password
#   - SSH won't allow passwd-less login w/o debug tweaks, so requires console login
#   - Set to immediately expire
#   - Add to the sudoers file
# * Add user to the audio group
# * Add user to the video group
IMAGE_CLASSES += "extrausers"
EXTRA_USERS_PARAMS ?= "\
    useradd -p '' tester; \
    groupadd -r aie; \
    usermod -a -G aie,audio,input,video tester; \
"
USERADDEXTENSION:append = " tester-useradd-sudoers"
EXTRA_USERS_SUDOERS ?= "user ALL=(ALL) ALL;"

IMAGE_FSTYPES += "tar.gz cpio.gz.u-boot ext4 ${@'wic' if (d.getVar('INITRAMFS_IMAGE') or '') == '' else ''}"
```

## conf/layer.conf
```bitbake
# We have a conf and classes directory, add to BBPATH
BBPATH =. "${LAYERDIR}:"

# We have recipes-* directories, add to BBFILES
BBFILES += "${LAYERDIR}/recipes-*/*/*.bb \
            ${LAYERDIR}/recipes-*/*/*.bbappend"

BBFILE_COLLECTIONS += "tester"
BBFILE_PATTERN_tester = "^${LAYERDIR}/"
BBFILE_PRIORITY_tester = "5"

LAYERSERIES_COMPAT_tester = "scarthgap"

# This should only be incremented on significant changes that will
# cause compatibility issues with other layers
LAYERVERSION_tester = "1"

LAYERDEPENDS_tester = " \
    core \
    xilinx \
    xilinx-standalone \
"

REQUIRED_POKY_BBLAYERS_CONF_VERSION = "2"
```

## conf/machine/zynqmp-tester.conf
```bitbake
#@TYPE: Machine
#@NAME: zynqmp-tester
#@DESCRIPTION: Machine configuration for the ZynqMP-based tester boards.

#### Preamble
MACHINEOVERRIDES =. "${@['', 'zynqmp-tester:']['zynqmp-tester' !='${MACHINE}']}"
#### Regular settings follow

# Yocto device-tree variables
YAML_CONSOLE_DEVICE_CONFIG:pn-device-tree ?= "psu_uart_0"
YAML_MAIN_MEMORY_CONFIG:pn-device-tree ?= "psu_ddr_0"
DT_PADDING_SIZE:pn-device-tree ?= "0x1000"
DTC_FLAGS:pn-device-tree ?= ""

# Yocto u-boot-xlnx variables
UBOOT_MACHINE ?= "xilinx_zynqmp_virt_defconfig"

# Yocto PMUFW variables
YAML_COMPILER_FLAGS:append:pn-pmu-firmware = " "
YAML_SERIAL_CONSOLE_STDIN:pn-pmu-firmware ?= "psu_uart_0"
YAML_SERIAL_CONSOLE_STDOUT:pn-pmu-firmware ?= "psu_uart_0"

# Yocto FSBL variables
YAML_SERIAL_CONSOLE_STDIN:pn-fsbl-firmware ?= "psu_uart_0"
YAML_SERIAL_CONSOLE_STDOUT:pn-fsbl-firmware ?= "psu_uart_0"

# Serial Console Settings
SERIAL_CONSOLES ?= "115200;ttyPS0"
YAML_SERIAL_CONSOLE_BAUDRATE ?= "115200"

# Yocto arm-trusted-firmware(TF-A) variables
ATF_CONSOLE ?= "cadence"
TFA_BL33_LOAD ?= "0x8000000"

# Set DDR Base address for u-boot-xlnx-scr variables
DDR_BASEADDR ?= "0x0"
SKIP_APPEND_BASEADDR ?= "0"

# Yocto KERNEL Variables
UBOOT_ENTRYPOINT  ?= "0x200000"
UBOOT_LOADADDRESS ?= "0x200000"

# Yocto MACHINE_FEATURES Variable
MACHINE_FEATURES += "mali400"

# Required generic machine inclusion
require conf/machine/zynqmp-generic.conf

# This is an 'XSCT' based BSP
XILINX_XSCT_VERSION = "2024.2"
XILINX_WITH_ESW = "xsct"

# Add system XSA
HDF_URI = "file://${TOPDIR}/../sources/meta-zynqmp-platform-tester/hw/system.xsa"
HDF_URI[sha256sum] = "26401febaba1bd11e9d55ca03109657025b4eb56d11e9c30d0bad1831aebf029"

#### No additional settings should be after the Postamble
#### Postamble
PACKAGE_EXTRA_ARCHS:append = "${@['', ' zynqmp_tester']['zynqmp-tester' != '${MACHINE}']}"
```
